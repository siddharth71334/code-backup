/**************************************************************************
 This is an example for our Monochrome OLEDs based on SSD1306 drivers

 Pick one up today in the adafruit shop!
 ------> http://www.adafruit.com/category/63_98

 This example is for a 128x64 pixel display using SPI to communicate
 4 or 5 pins are required to interface.

 Adafruit invests time and resources providing this open
 source code, please support Adafruit and open-source
 hardware by purchasing products from Adafruit!

 Written by Limor Fried/Ladyada for Adafruit Industries,
 with contributions from the open source community.
 BSD license, check license.txt for more information
 All text above, and the splash screen below must be
 included in any redistribution.
 **************************************************************************/

#include <SPI.h>
#include <Wire.h>
#include <Adafruit_GFX.h>
#include <Adafruit_SSD1306.h>

#define SCREEN_WIDTH 128 // OLED display width, in pixels
#define SCREEN_HEIGHT 64 // OLED display height, in pixels
#include <Fonts/FreeSans9pt7b.h>
#include <Fonts/FreeSans12pt7b.h>
#include <Fonts/FreeMonoOblique18pt7b.h>
#include <Fonts/FreeSerif9pt7b.h>

// Declaration for SSD1306 display connected using software SPI (default case):
#define OLED_MOSI   11
#define OLED_CLK   13
#define OLED_DC    12
#define OLED_CS    4
#define OLED_RESET 8
Adafruit_SSD1306 display(SCREEN_WIDTH, SCREEN_HEIGHT,
  OLED_MOSI, OLED_CLK, OLED_DC, OLED_RESET, OLED_CS);

  int RX = 3;
int pin_state= 0;
unsigned long counter = 0;
unsigned long prev_counter = 0;
long DELAY = 0;
float freq = 0;

int i=0;
  int j=0;
  int x=0;
  int y=0;



unsigned long previousMillis = 0; 

const unsigned char PROGMEM frame0 [] = {
0x00, 0x00, 0x1f, 0xff, 0xff, 0xff, 0xff, 0xff, 0xff, 0xff, 0xff, 0xff, 0xff, 0xf8, 0x00, 0x00, 
  0x00, 0x00, 0x1f, 0xff, 0xff, 0xff, 0xff, 0xff, 0xff, 0xff, 0xff, 0xff, 0xff, 0xf8, 0x00, 0x00, 
  0x00, 0x00, 0x1f, 0xff, 0xff, 0xff, 0xff, 0xff, 0xff, 0xff, 0xff, 0xff, 0xff, 0xf8, 0x00, 0x00, 
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  0x00, 0x00, 0x1f, 0xff, 0xff, 0xff, 0xff, 0xff, 0xff, 0xff, 0xff, 0xff, 0xff, 0xf8, 0x00, 0x00

};

void setup() {
  Serial.begin(9600);

  // SSD1306_SWITCHCAPVCC = generate display voltage from 3.3V internally
  if(!display.begin(SSD1306_SWITCHCAPVCC)) {
    Serial.println(F("SSD1306 allocation failed"));
    for(;;); // Don't proceed, loop forever

Serial.begin(9600);
  pinMode(RX,INPUT);
  pinMode(13,OUTPUT);


    
  }


  display.clearDisplay();

  display.setFont(&FreeSans12pt7b);
  display.setTextColor(1);
  display.setCursor(0,22);
   display.println("  i mpulse\n   projects");
  
  display.invertDisplay(true);
  display.display();

delay(2000);

display.display();
 display.clearDisplay();
display.drawBitmap(0, 0,frame0,128,64, 1);

display.display();
delay(2000);

display.clearDisplay();

display.setFont(&FreeSerif9pt7b);
// display.setTextSize();             
  display.setTextColor(1);
  display.setCursor(0,15);             
 display.println(" This is RF \n tracking device");
 display.setFont();
 display.println(" by - siddharth sahu");
 display.display();
delay(500);
display.clearDisplay();

//display.setFont();
//display.setTextColor(1);
//display.setTextSize(1);
//display.setCursor(0,25);
//display.println(" Device is ");
//display.display();

  
}
void loop() {


unsigned long currentMillis = millis();  
  if(currentMillis - previousMillis >= 100)
  {
    previousMillis += 100;
  if (j==50){
i=0;
j=0;
x=0;
y=0;
}
j=j+1;
      
      
       Serial.println(DELAY);
       if(DELAY>=200 && DELAY<=390){
      i=i+1;
       }

Serial.println(j);

      if(i>=45){
        x=1;
  Serial.println("in range");

  

      }

      if(i>=30){
        
        y=1;
        
     if (x==0 && y==1 ){   
  Serial.println("in range22");
  
display.invertDisplay(true);
  display.clearDisplay();
  display.setFont();
display.setTextColor(1);
display.setTextSize(1);
display.setCursor(0,25);
display.println(" Device is in range 2 ");
display.display();
     }
      
  }
  }
  
  if(x==1 && y==1){
  display.invertDisplay(true);
  display.clearDisplay();
  display.setFont();
display.setTextColor(1);
display.setTextSize(1);
display.setCursor(0,25);
display.println(" Device is in range 1 ");
display.display();
  }

  
 if(digitalRead(RX) && pin_state== 0)
 {
  pin_state=1;
  prev_counter = micros();
 }

 if(!digitalRead(RX) && pin_state== 1)
 {
  pin_state=0;
  counter = micros();
  DELAY = counter - prev_counter;   
 }
 
  
  
 
  
 
}
